## conf/machine/include/bootloaders.inc
```bitbake
# Add bootloaders to the images of every machine
EXTRA_IMAGEDEPENDS += "at91bootstrap-rba5d2x virtual/bootloader"
```

## conf/machine/rugged-board-a5d2x.conf
```bitbake
#@TYPE: Machine
#@Name: RUGGED BOARD A5D2X QSPI
#@DESCRIPTION: Machine configuration for rugged board a5d2x

require include/sama5d2.inc

MACHINE_FEATURES = "apm alsa ext2 ext3 usbhost usbgadget touchscreen"
KERNEL_DEVICETREE = " \
		a5d2x-rugged_board.dtb \
		"

do_image_wic[depends] += "uboot-rba5d2x:do_deploy"
WKS_FILE = "sdimage-bootpart.wks"
IMAGE_BOOT_FILES = "BOOT.BIN u-boot.bin"
#CORE_IMAGE_EXTRA_INSTALL += " kernel-modules"

MKUBIFS_ARGS = " -e 0x1f000 -c 4000 -m 0x800 -x lzo"
UBINIZE_ARGS = " -m 0x800 -p 0x20000"

UBI_VOLNAME = "rootfs"

UBOOT_MACHINE ?= "rugged_board_a5d2x_qspiflash_defconfig"
UBOOT_ENTRYPOINT = "0x20008000"
UBOOT_LOADADDRESS = "0x20008000"

AT91BOOTSTRAP_MACHINE ?= "rugged_board_a5d2x"

# Needed for FIT
MACHINE_ESSENTIAL_EXTRA_RDEPENDS = " dt-overlay-at91"
export PYTHONDONTWRITEBYTECODE="0"
INCLUDE_PYCS=""
RDEPENDS_${KERNEL_PACKAGE_NAME}-base = ""
IMAGE_FSTYPES = "squashfs tar.gz"

QB_DEFAULT_FSTYPE = "${IMAGE_FSTYPES}"
```
